## firmware/main/Kconfig.projbuild
```kconfig
menu "Xiaozhi Assistant"

config USE_EMOTE_MESSAGE_STYLE
    bool "Use rawdraw 1bpp rendering (no LVGL)"
    default y
    help
        When enabled, the display uses rawdraw 1bpp framebuffer rendering
        instead of LVGL. This is the recommended mode for the ZecTrix
        S3 E-Paper 4.2 board as LVGL causes frequent crashes.

config OTA_URL
    string "OTA configuration URL"
    default "https://api.tenclass.net/xiaozhi/ota/"
    help
        Endpoint used to discover the WebSocket URL and token when the
        websocket NVS namespace has not been provisioned yet.

config BOARD_TYPE_ZECTRIX_S3_EPAPER_4_2
    bool "zectrix-s3-epaper-4.2 FT firmware"
    default y
    depends on IDF_TARGET_ESP32S3
    help
        This local repository has been reduced to a single FT-only firmware
        for the zectrix-s3-epaper-4.2 board.

choice ZECTRIX_EPD_PANEL_TYPE
    prompt "ZecTrix EPD panel type"
    default ZECTRIX_EPD_PANEL_4COLOR_SSD2683
    depends on BOARD_TYPE_ZECTRIX_S3_EPAPER_4_2
    help
        Select the e-paper panel connected to the board. The 4-color option
        keeps the existing 1bpp UI framebuffer and converts it to the SSD2683
        2bpp wire format during refresh.

config ZECTRIX_EPD_PANEL_1BPP
    bool "1bpp black/white EPD"

config ZECTRIX_EPD_PANEL_4COLOR_SSD2683
    bool "4-color BWRY SSD2683 EPD"

endchoice

config ZECTRIX_EPD_4COLOR_BOOT_TEST_PATTERN
    bool "Show 4-color EPD test pattern at boot"
    default n
    depends on ZECTRIX_EPD_PANEL_4COLOR_SSD2683
    help
        Show black/white/red/yellow vertical bars once during display
        initialization so a newly connected 4-color panel can be verified.

endmenu
```
